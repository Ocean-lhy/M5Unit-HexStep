## sdkconfig.defaults
```kconfig
# ESP32-S3 is the host SoC on ESP-Thread-Border-Router board
CONFIG_IDF_TARGET="esp32"

#
# Serial flasher config
#
CONFIG_ESPTOOLPY_FLASHSIZE_8MB=y
# end of Serial flasher config

#
# Partition Table
#
CONFIG_PARTITION_TABLE_CUSTOM=y
CONFIG_PARTITION_TABLE_CUSTOM_FILENAME="partitions.csv"
CONFIG_PARTITION_TABLE_FILENAME="partitions.csv"
CONFIG_PARTITION_TABLE_OFFSET=0x8000
CONFIG_PARTITION_TABLE_MD5=y
# end of Partition Table

#
# Compiler options
#
CONFIG_COMPILER_OPTIMIZATION_SIZE=y

#
# ESP System Settings
#
CONFIG_ESP_SYSTEM_EVENT_TASK_STACK_SIZE=3584
# end of ESP System Settings

#
# ESP-Driver:I2C Configurations
#
CONFIG_I2C_ENABLE_SLAVE_DRIVER_VERSION_2=y
# end of ESP-Driver:I2C Configurations
# CONFIG_CODEC_I2C_BACKWARD_COMPATIBLE is not set

CONFIG_I2C_BUS_REMOVE_NULL_MEM_ADDR=y

CONFIG_LV_COLOR_16_SWAP=y
```
